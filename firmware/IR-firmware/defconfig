## firmware/IR-firmware/defconfig
```kconfig
# Important: This is for ESP32-S3 devkitm. If you have a different board, the naming may be different. 

# For Arduino framework to work
CONFIG_AUTOSTART_ARDUINO=y
CONFIG_FREERTOS_HZ=1000

# Bluetooth must be enabled with NimBLE
# Allow it to auto sleep with the external clock
# And reduce its signal strength to 0dB (reduce current draw)
CONFIG_BT_ENABLED=y
CONFIG_BT_CTRL_DFT_TX_POWER_LEVEL_N0=y
CONFIG_BT_CTRL_MODEM_SLEEP=y
CONFIG_BT_CTRL_LPCLK_SEL_EXT_32K_XTAL=y
CONFIG_BT_NIMBLE_ENABLED=y
CONFIG_ESP32S3_RTC_CLK_SRC_EXT_CRYS=y

# Enable the power management
CONFIG_PM_ENABLE=y
CONFIG_FREERTOS_USE_TICKLESS_IDLE=y
```
